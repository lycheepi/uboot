## board/freescale/imx8qm_iwg27m/Kconfig
```kconfig
if TARGET_IMX8QM_IWG27M

config SYS_BOARD
	default "imx8qm_iwg27m"

config SYS_VENDOR
	default "freescale"

config SYS_CONFIG_NAME
	default "imx8qm_iwg27m"

endif

if TARGET_IMX8QM_IWG27M_MFG

config SYS_BOARD
        default "imx8qm_iwg27m"

config SYS_VENDOR
        default "freescale"

config SYS_CONFIG_NAME
        default "imx8qm_iwg27m_mfg"

endif
```

## configs/imx8qm_iwg27m_defconfig
```kconfig
CONFIG_ARM=y
CONFIG_ARCH_IMX8=y
CONFIG_DEFAULT_DEVICE_TREE="fsl-imx8qm-iwg27m"
CONFIG_TARGET_IMX8QM_IWG27M=y
CONFIG_CMD_IMPORTENV=n
CONFIG_SYS_TEXT_BASE=0x80020000
CONFIG_SYS_MALLOC_F_LEN=0x2000
CONFIG_DM=y
CONFIG_CMD_CACHE=y

CONFIG_DM_SERIAL=y
CONFIG_FSL_LPUART=y
CONFIG_OF_CONTROL=y
CONFIG_DM_I2C=y
# CONFIG_DM_I2C_COMPAT is not set
CONFIG_SYS_I2C_IMX_LPI2C=y
CONFIG_CMD_I2C=y

CONFIG_USB_XHCI_HCD=y
CONFIG_USB_XHCI_IMX8=y

CONFIG_DM_USB=y
CONFIG_USB_EHCI_HCD=y

CONFIG_CMD_USB=y
CONFIG_USB=y
CONFIG_USB_STORAGE=y

CONFIG_CMD_USB_MASS_STORAGE=y
CONFIG_USB_GADGET=y
CONFIG_CI_UDC=y
CONFIG_USB_GADGET_DOWNLOAD=y
CONFIG_USB_GADGET_MANUFACTURER="FSL"
CONFIG_USB_GADGET_VENDOR_NUM=0x0525
CONFIG_USB_GADGET_PRODUCT_NUM=0xa4a5

CONFIG_CMD_GPIO=y
CONFIG_DM_GPIO=y
CONFIG_GPIO_SMARC_UNUSED=y
CONFIG_DM_PCA953X=n
CONFIG_BOOTDELAY=3
CONFIG_IMX_BOOTAUX=y
CONFIG_FS_FAT=y
CONFIG_CMD_FAT=y
CONFIG_CMD_MMC=y
CONFIG_DM_MMC=y
CONFIG_MMC_IO_VOLTAGE=y
CONFIG_MMC_UHS_SUPPORT=y
CONFIG_MMC_HS400_SUPPORT=y
CONFIG_FSL_FSPI=y
CONFIG_DM_SPI=y
CONFIG_DM_SPI_FLASH=y
CONFIG_SPI_FLASH=y
CONFIG_SPI_FLASH_4BYTES_ADDR=y
CONFIG_SPI_FLASH_STMICRO=y
CONFIG_CMD_SF=y

CONFIG_CMD_PING=y
CONFIG_CMD_DHCP=y
CONFIG_CMD_MII=y
CONFIG_DM_ETH=y
# CONFIG_EFI_LOADER is not set

CONFIG_DM_REGULATOR=y
CONFIG_DM_REGULATOR_FIXED=y
CONFIG_DM_REGULATOR_GPIO=y

CONFIG_VIDEO=y
#
# Graphics support
#
# CONFIG_DM_VIDEO is not set

#
# TrueType Fonts
#
# CONFIG_VIDEO_VESA is not set
# CONFIG_VIDEO_LCD_ANX9804 is not set
# CONFIG_VIDEO_LCD_SSD2828 is not set
# CONFIG_VIDEO_LCD_HITACHI_TX18D42VM is not set
# CONFIG_VIDEO_MVEBU is not set
# CONFIG_I2C_EDID is not set
# CONFIG_DISPLAY is not set
# CONFIG_VIDEO_TEGRA20 is not set
# CONFIG_VIDEO_BRIDGE is not set
# CONFIG_VIDEO_IMXDPUV1 is not set
CONFIG_VIDEO_IMX_HDP_LOAD=y
CONFIG_CFB_CONSOLE=y
# CONFIG_CFB_CONSOLE_ANSI is not set
CONFIG_VGA_AS_SINGLE_DEVICE=y
CONFIG_VIDEO_SW_CURSOR=y
# CONFIG_CONSOLE_EXTRA_INFO is not set
CONFIG_CONSOLE_SCROLL_LINES=1
# CONFIG_VIDEO_CT69000 is not set
CONFIG_SYS_CONSOLE_BG_COL=0x00
CONFIG_SYS_CONSOLE_FG_COL=0xa0
# CONFIG_LCD is not set


CONFIG_PINCTRL=y
CONFIG_PINCTRL_IMX8=y

CONFIG_POWER_DOMAIN=y
CONFIG_IMX8_POWER_DOMAIN=y

CONFIG_DM_THERMAL=y
CONFIG_IMX_SC_THERMAL=y

CONFIG_ENV_IS_IN_MMC=y

CONFIG_SMC_FUSE=y
CONFIG_CMD_MEMTEST=y

CONFIG_BOOTAUX_RESERVED_MEM_BASE=0x88000000
CONFIG_BOOTAUX_RESERVED_MEM_SIZE=0x08000000
```

## configs/imx8qm_iwg27m_mfg_defconfig
```kconfig
CONFIG_ARM=y
CONFIG_ARCH_IMX8=y
CONFIG_DEFAULT_DEVICE_TREE="fsl-imx8qm-iwg27m"
# CONFIG_TARGET_IMX8QM_LPDDR4_ARM2 is not set
CONFIG_TARGET_IMX8QM_IWG27M_MFG=y
CONFIG_CMD_IMPORTENV=n
CONFIG_SYS_MALLOC_F_LEN=0x2000
CONFIG_DM=y
CONFIG_CMD_CACHE=y

CONFIG_DM_SERIAL=y
CONFIG_FSL_LPUART=y
CONFIG_OF_CONTROL=y
CONFIG_DM_I2C=y
# CONFIG_DM_I2C_COMPAT is not set
CONFIG_SYS_I2C_IMX_LPI2C=y
CONFIG_CMD_I2C=y

CONFIG_USB_XHCI_HCD=y
CONFIG_USB_XHCI_IMX8=y

CONFIG_DM_USB=y
CONFIG_USB_EHCI_HCD=y

CONFIG_CMD_USB=y
CONFIG_USB=y
CONFIG_USB_STORAGE=y

CONFIG_CMD_USB_MASS_STORAGE=y
CONFIG_USB_GADGET=y
CONFIG_CI_UDC=y
CONFIG_USB_GADGET_DOWNLOAD=y
CONFIG_G_DNL_MANUFACTURER="FSL"
CONFIG_G_DNL_VENDOR_NUM=0x0525
CONFIG_G_DNL_PRODUCT_NUM=0xa4a5

CONFIG_CMD_GPIO=y
CONFIG_DM_GPIO=y
CONFIG_DM_PCA953X=n
CONFIG_BOOTDELAY=0
CONFIG_IMX_BOOTAUX=y
CONFIG_CMD_FAT=y
CONFIG_CMD_MMC=y
CONFIG_DM_MMC=y
# CONFIG_BLK is not set
# CONFIG_DM_MMC_OPS is not set
CONFIG_FSL_FSPI=y
CONFIG_DM_SPI=y
CONFIG_DM_SPI_FLASH=y
CONFIG_SPI_FLASH=y
CONFIG_SPI_FLASH_4BYTES_ADDR=y
CONFIG_SPI_FLASH_STMICRO=y
CONFIG_CMD_SF=y

CONFIG_CMD_PING=y
CONFIG_CMD_DHCP=y
CONFIG_CMD_MII=y
CONFIG_DM_ETH=y
# CONFIG_EFI_LOADER is not set

CONFIG_DM_REGULATOR=y
CONFIG_DM_REGULATOR_FIXED=y
CONFIG_DM_REGULATOR_GPIO=y

#CONFIG_VIDEO=y
#
# Graphics support
#
# CONFIG_DM_VIDEO is not set

#
# TrueType Fonts
#
# CONFIG_VIDEO_VESA is not set
# CONFIG_VIDEO_LCD_ANX9804 is not set
# CONFIG_VIDEO_LCD_SSD2828 is not set
# CONFIG_VIDEO_LCD_HITACHI_TX18D42VM is not set
# CONFIG_VIDEO_MVEBU is not set
# CONFIG_I2C_EDID is not set
# CONFIG_DISPLAY is not set
# CONFIG_VIDEO_TEGRA20 is not set
# CONFIG_VIDEO_BRIDGE is not set
# CONFIG_VIDEO_IMXDPUV1 is not set
# CONFIG_VIDEO_IMX_HDP_LOAD is not set
# CONFIG_CFB_CONSOLE is not set
# CONFIG_VIDEO_CT69000 is not set
# CONFIG_LCD is not set


CONFIG_PINCTRL=y
CONFIG_PINCTRL_IMX8=y

CONFIG_POWER_DOMAIN=y
CONFIG_IMX8_POWER_DOMAIN=y

CONFIG_DM_THERMAL=y
CONFIG_IMX_SC_THERMAL=y
```
